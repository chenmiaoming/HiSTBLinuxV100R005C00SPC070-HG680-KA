/*
 * FiberHome HG-680-KA board overrides for Hi3798MV310.
 *
 * Keep the vendor DTS as an immutable baseline and layer the board-specific
 * SDIO wiring on top.  The HG-680-KA uses an on-board MediaTek MT7668.  Phase
 * A intentionally stops at SDIO enumeration; no MT7668 WLAN/BT function is
 * described here.
 */
#include "hi3798mv310-vendor.dtsi"

/* Remove the reference-board 6222B/RTL8822CS description. */
/delete-node/ &sdio_pwrseq;
/delete-node/ &bluetooth;
/delete-node/ &sdio;
/delete-node/ &clk_32k;

/ {
	model = "FiberHome HG-680-KA";
	compatible = "fiberhome,hg680-ka", "hi3798mv310-series";

	aliases {
		/delete-property/ sdio;
		/delete-property/ wlan0;
		/delete-property/ bluetooth0;
		sdio = &hg680ka_sdio;
	};

	/*
	 * Board helper matching the stock hi_sdio_detect.ko sequence:
	 * GPIO4_3 (global GPIO35) controls WLAN_REG_ON and bit 0 at
	 * 0xf9a20008 feeds SDIO1 card-present into the HiSilicon host.
	 *
	 * This helper is built as hi_sdio_detect.ko for Phase A so that the
	 * SDIO function can be powered/enumerated independently of the WLAN
	 * driver.  Loading the module should make 037a:7608 appear on SDIO.
	 */
	hg680ka_sdio_power: sdio-wifi-power@0xf9a20008 {
		compatible = "fiberhome,hg680-ka-sdio-power";
		reg = <0xf9a20008 0x4>;
		wlan-reg-on-gpios = <&gpio4 3 GPIO_ACTIVE_HIGH>;
		status = "okay";
	};

	/*
	 * SDIO1 host at 0xf9c40000.  Use the vendor himciv300 driver through
	 * its historical hi3798mv310,himciv200 DT compatible.  This matches
	 * the vendor MV310 DTS backup and the host driver's f9c40000 SDIO1
	 * clock/phase handling.
	 */
	hg680ka_sdio: himciv200.SD@0xf9c40000 {
		compatible = "hi3798mv310,himciv200";
		reg = <0xf9c40000 0x1000>, <0xf8a21090 0x20>;
		interrupts = <0 86 4>;

		clocks = <&hisilicon_clock PERI_CRG163_SDIO2>;
		clock-names = "clk";

		caps = <0x8007000f>;
		caps2 = <0x4000>;
		max-frequency = <50000000>;
		status = "okay";
	};
};
