## source/kernel/linux-4.4.y/Documentation/devicetree/bindings/mmc/fiberhome,hg680-ka-sdio-power.txt
```
FiberHome HG-680-KA SDIO power/card-detect helper
================================================

This binding describes the small board-specific helper used to reproduce the
stock HG-680-KA hi_sdio_detect.ko sequence during SDIO bring-up.  It is not a
Wi-Fi device binding and does not describe the MT7668 function itself.

Required properties:
- compatible: must be "fiberhome,hg680-ka-sdio-power"
- reg: physical system-control register containing the SDIO1 card-present bit;
  on HG-680-KA this is <0xf8a20008 0x4> and bit 0 is used
- wlan-reg-on-gpios: GPIO driving WLAN_REG_ON; on HG-680-KA this is GPIO4_3,
  active high

Example:

	sdio-wifi-power@0xf8a20008 {
		compatible = "fiberhome,hg680-ka-sdio-power";
		reg = <0xf8a20008 0x4>;
		wlan-reg-on-gpios = <&gpio4 3 GPIO_ACTIVE_HIGH>;
	};

The Phase-A driver is normally built as hi_sdio_detect.ko.  Loading the module
powers WLAN_REG_ON, waits for the module to settle, and asserts SDIO1
card-present.  The expected next observable result is enumeration of the
MediaTek SDIO function (vendor 0x037a, device 0x7608).  Firmware loading and a
WLAN network interface belong to the later driver phase.
```

## source/kernel/linux-4.4.y/drivers/mmc/host/himciv300/Kconfig
```kconfig
#
# himci v300 device configuration
#

config HIMCIV300_SDIO_SYNOPSYS
	tristate "Himciv300 SDIO/MMC device support"
	depends on ARCH_HI3798MV2X || ARCH_HI3796MV2X || ARCH_HI3798MV310
	default n
	select MMC_UNSAFE_RESUME
	select MMC_EMBEDDED_SDIO
	select MMC_BLOCK
	select MMC_BLOCK_BOUNCE
	help
	  This selects the mmc family device.

config HG680KA_SDIO_DETECT
	tristate "FiberHome HG-680-KA SDIO power/card-detect helper"
	depends on ARCH_HI3798MV310 && OF && GPIOLIB
	help
	  Build the board helper used during HG-680-KA Wi-Fi Phase A bring-up.
	  The helper controls WLAN_REG_ON through GPIO4_3 and asserts SDIO1
	  card-present through bit 0 of the HiSilicon system-control register at
	  0xf8a20008.  It does not contain an MT7668 WLAN or Bluetooth driver.

	  Build this as a module during Phase A.  Loading hi_sdio_detect.ko
	  should cause the on-board MediaTek SDIO function (expected 037a:7608)
	  to enumerate on the existing HiSilicon MMC/SDIO host.
```
